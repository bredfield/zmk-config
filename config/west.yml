## config/west.yml
```yaml
manifest:
  remotes:
    - name: zmkfirmware
      url-base: https://github.com/zmkfirmware
    - name: urob
      url-base: https://github.com/urob
    - name: bredfield
      url-base: https://github.com/bredfield
  projects:
    - name: zmk
      remote: bredfield
      revision: main
      import: app/west.yml
  self:
    path: config
```
